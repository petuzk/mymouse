## MouseV2-nRF/adns7530_driver/zephyr/Kconfig
```kconfig
# Copyright (c) 2019 Nordic Semiconductor
# SPDX-License-Identifier: Apache-2.0

menuconfig ADNS7530
	bool "ADNS-7530 optical motion sensor"
	depends on GPIO && SPI
	help
	  Enable driver for PixArt ADNS-7530 SPI-based optical motion sensor.

if ADNS7530

config ADNS7530_SURF_QUAL_THRESHOLD
	int "Surface quality threshold"
	range 0 242
	default 120
	help
	  Readings indicating surface quality lower than the given threshold are ignored.

endif # ADNS7530
```

## MouseV2-nRF/boards/arm/mousev2/Kconfig.board
```kconfig
# Copyright (c) 2021 Taras Radchenko
# SPDX-License-Identifier: MIT

config BOARD_MOUSEV2
	bool "MouseV2"
	depends on SOC_NRF52832_QFAA

if BOARD_MOUSEV2

config BOARD_VDD_EN_INIT_PRIORITY
	int "VDD power rail init priority"
	default 50
	depends on GPIO
	help
	  Initialization priority for the VDD power rail. Has to be greater
	  than GPIO_NRF_INIT_PRIORITY, but smaller than SENSOR_INIT_PRIORITY.

endif # BOARD_MOUSEV2
```

## MouseV2-nRF/boards/arm/mousev2/Kconfig.defconfig
```kconfig
# Copyright (c) 2021 Nordic Semiconductor ASA
# SPDX-License-Identifier: Apache-2.0

if BOARD_MOUSEV2

config BOARD
	default "mousev2"

config BT_CTLR
   default BT

endif
```

## MouseV2-nRF/boards/arm/mousev2/mousev2_defconfig
```kconfig
# Copyright (c) 2021 Taras Radchenko
# SPDX-License-Identifier: MIT

CONFIG_SOC_SERIES_NRF52X=y
CONFIG_SOC_NRF52832_QFAA=y
CONFIG_BOARD_MOUSEV2=y

# Enable GPIO-controlled regulator
CONFIG_GPIO=y
CONFIG_REGULATOR=y

# Enable MPU
CONFIG_ARM_MPU=y

# Enable hardware stack protection
CONFIG_HW_STACK_PROTECTION=y

# Use reset & NFC pins as regular GPIOs
CONFIG_NFCT_PINS_AS_GPIOS=y
CONFIG_GPIO_AS_PINRESET=n
```

## app-nrf/src/Kconfig
```kconfig
# rsource "drivers/Kconfig"
rsource "platform/Kconfig"
rsource "services/Kconfig"
rsource "shell/Kconfig"
rsource "transport/Kconfig"
```

## app-nrf/src/drivers/Kconfig
```kconfig
config ADNS7530_SURF_QUAL_THRESHOLD
	int "Surface quality threshold"
	range 0 242
	default 120
	help
	  Readings indicating surface quality lower than the given threshold are ignored.
```

## app-nrf/src/platform/Kconfig
```kconfig
config BOOT_COND_INIT_PRIORITY
  int "Boot condition check init priority"
  default 45
  help
    Init priority of boot condition check, which verifies
    whether the power button is being held long enough.
    It is executed in PRE_KERNEL_1 stage and should be done
    as early as possible to prevent further system boot
    when boot condition is not met. Should be done after MPSL,
    i.e. this value should be greater than
    KERNEL_INIT_PRIORITY_DEFAULT.

config PLATFORM_INIT_PRIORITY
  int "Platform init priority"
  default 50
  help
    Init priority of SoC subsystems at POST_KERNEL stage.

config SKIP_BOOT_CONDITION
  bool "Skip boot condition check"
  default n
  help
    If true, boot condition check will be skipped.
    The platform will start regardless of the power on button.

config POWER_ON_OFF_HOLD_TIME
  int "Power switch hold time"
  default 1000
  help
    A number of milliseconds the power switch
    has to be held to power the device on or off.
```

## app-nrf/src/services/Kconfig
```kconfig
rsource "hid/Kconfig"

config APP_BOOTOPTS_INIT_PRIORITY
  int "Boot options init priority"
  default 10
  help
    Init priority for boot options detection.
    No dependencies to other services.

config APP_BATTERY_MEAS_THREAD_STACK_SIZE
  int "Battery measurement thread stack size"
  default 1024

config APP_BATTERY_MEAS_THREAD_PRIORITY
  int "Battery measurement thread priority"
  default 13
  help
    Apparently the priority of this thread has to be
    higher than the prio of logging or shell_rtt threads.
    It seems that otherwise this thread is blocked
    until the shell is connected.

config APP_BATTERY_MEAS_PERIOD_SEC
  int "Battery measurement period (seconds)"
  default 120

config APP_BUTTON_MODE_INIT_PRIORITY
  int "Mode button init priority"
  default 95
  help
    This should be the last step of initialization.
    Successfull boot is signalled to the user with
    current battery level information.

config APP_DEBOUNCE_NUM_SHIFTS
  int "Value of parameter N, see debounce.c"
  default 5

config APP_DEBOUNCE_TIMER_PERIOD
  int "Value of parameter T (in microseconds), see debounce.c"
  default 1000
```

## app-nrf/src/services/hid/Kconfig
```kconfig
rsource "sink/Kconfig"

config APP_HID_COLLECTOR_THREAD_STACK_SIZE
  int "HID collector thread stack size"
  default 1024

config APP_HID_COLLECTOR_THREAD_PRIORITY
  int "HID collector thread priority"
  default 0
```

## app-nrf/src/services/hid/sink/Kconfig
```kconfig
choice APP_HID_SINK_CHOICE
  prompt "HID sink implementation"
  default APP_HID_SINK_STUB

config APP_HID_SINK_STUB
  bool "Stub (logging only)"

config APP_HID_SINK_TRANSPORT
  bool "Directly send to transport"

endchoice
```

## app-nrf/src/services/hid/source/Kconfig
```kconfig
config APP_HID_SOURCE_INIT_PRIORITY
  int "HID sources init priority (shared)"
  default 15

config APP_HID_SOURCE_BUTTONS_PRIORITY
  int "Buttons HID source priority"
  range 0 9
  default 3

config APP_HID_SOURCE_ENCODER_PRIORITY
  int "Encoder HID source priority"
  range 0 9
  default 5

config APP_HID_SOURCE_OPT_SENSOR_PRIORITY
  int "Optical sensor HID source priority"
  range 0 9
  default 1
```

## app-nrf/src/shell/Kconfig
```kconfig
config APP_SHELL_HID_REPORT
  bool "Enable HID report shell"
  default false
  help
    Adds commands allowing to modify HID report.
    Helpful to simulate physical interaction with a HID device.

config APP_SHELL_PLATFORM
  bool "Enable platform shell"
  default false
  help
    Adds hardware control commands.

config APP_SHELL_SERVICES
  bool "Enable services shell"
  default false

config APP_SHELL_HID_SRC_COLL
  bool "Enable HID sources & collector shell"
  default false

config APP_HID_SOURCE_SHELL_PRIORITY
  int "Shell HID source priority"
  default 7
  range 0 9
```

## app-nrf/src/transport/Kconfig
```kconfig
config APP_TRANSPORT_INIT_PRIORITY
  int "Transport init priority"
  default 30
  help
    Init priority of transport provider. At this step
    bluetooth is initialized.
```

## boards/arm/mousev2/Kconfig
```kconfig
config BOARD_ENABLE_DCDC
  bool "Enable DCDC mode"
  select SOC_DCDC_NRF52X
  default y
  depends on BOARD_MOUSEV2


config BOARD_VDD_EN_INIT_PRIORITY
  int "VDD power rail init priority"
  default 50
  depends on GPIO
  help
    Initialization priority for the VDD power rail. Has to be greater
    than GPIO_NRF_INIT_PRIORITY, but smaller than SENSOR_INIT_PRIORITY.
```

## boards/arm/mousev2/Kconfig.board
```kconfig
# Copyright (c) 2021 Taras Radchenko
# SPDX-License-Identifier: MIT

config BOARD_MOUSEV2
  bool "MouseV2"
  depends on SOC_NRF52832_QFAA
```

## boards/arm/mousev2/dts/bindings/microchip,atmega-spi-slave.yaml
```yaml
# Copyright (c) 2024 Taras Radchenko
# SPDX-License-Identifier: MIT

description: ATmega as SPI slave with IRQ GPIO.

compatible: "atmega-spi-slave"

include: "spi-device.yaml"

properties:
  irq-gpios:
    type: phandle-array
    required: true
    description: IRQ pin.
```

## boards/arm/mousev2/mousev2_defconfig
```kconfig
# Copyright (c) 2021 Taras Radchenko
# SPDX-License-Identifier: MIT

CONFIG_SOC_SERIES_NRF52X=y
CONFIG_SOC_NRF52832_QFAA=y
CONFIG_BOARD_MOUSEV2=y

# Configure reset & NFC pins as regular GPIOs
CONFIG_NFCT_PINS_AS_GPIOS=y
CONFIG_GPIO_AS_PINRESET=n

# Enable DC/DC converter
CONFIG_BOARD_ENABLE_DCDC=y

# Enable MPU & hardware stack protection
CONFIG_ARM_MPU=y
CONFIG_HW_STACK_PROTECTION=y
```

## modules/log_backend_my_fs/zephyr/Kconfig
```kconfig
config LOG_BACKEND_MY_FS
	bool "Enable modified LOG FS backend"
	depends on LOG && FILE_SYSTEM

if LOG_BACKEND_MY_FS

config LOG_BACKEND_MY_FS_DIR
	string "Directory to store logs in"
	default "/log"

config LOG_BACKEND_MY_FS_FILE_PREFIX
	string "Prefix of log filename"
	default "log."

config LOG_BACKEND_MY_FS_FILE_SIZE
	int "Max size of log file (bytes)"
	default 2048

config LOG_BACKEND_MY_FS_OVERWRITE
	bool "Whether to overwrite old logs"
	default y

config LOG_BACKEND_MY_FS_FILES_LIMIT
	int "Maximum number of files to store"
	default 10

endif
```

## modules/my_fs_shell/zephyr/Kconfig
```kconfig
config MY_FILE_SYSTEM_SHELL
	bool "Enable modified file system shell"
	depends on SHELL && FILE_SYSTEM
	help
	  This shell is a modified version of default FILE_SYSTEM_SHELL
	  with "fs mount" command made optional. Disabling it allows to
	  get rid of non-zero HEAP_MEM_POOL_SIZE requirement, because
	  k_malloc is only used for this command.

if MY_FILE_SYSTEM_SHELL

config MY_FILE_SYSTEM_SHELL_ENABLE_MOUNT
	bool "Enable fs mount command"
	depends on HEAP_MEM_POOL_SIZE > 0 && (FAT_FILESYSTEM_ELM || FILE_SYSTEM_LITTLEFS)

endif
```
