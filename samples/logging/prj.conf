## prj.conf
```kconfig
# enable deferred logging in a separate thread, with printk redirected to logging subsystem too
CONFIG_LOG=y
CONFIG_LOG_MODE_DEFERRED=y
CONFIG_LOG_PRINTK=y

# use segger rtt as logging backend
CONFIG_USE_SEGGER_RTT=y
CONFIG_LOG_BACKEND_RTT=y

# help for retry_delay suggests to incerease delay & retry count for heavy traffic
# these values are verified to ensure robust logging with up to 500 messages sent in a loop
# however, it requires blocking to ensure delivery, and will likely cause significant delay when traffic is high
# if message drop is acceptable, blocking can be disabled
CONFIG_LOG_BLOCK_IN_THREAD=y
CONFIG_LOG_BACKEND_RTT_RETRY_DELAY_MS=10
CONFIG_LOG_BACKEND_RTT_RETRY_CNT=20
```

## src/main.c
```c
#include <zephyr.h>
#include <sys/printk.h>
#include <logging/log.h>

LOG_MODULE_REGISTER(hwmain, LOG_LEVEL_DBG);

void main(void)
{
	const int delay = 1000;

	printk("Hello World! %s\n", CONFIG_BOARD);
	LOG_INF("Starting spam in %d ms", delay);

	k_msleep(delay);

	for (int i = 0; i < 500; i++) {
		LOG_INF("spam #%d: blah blah bruh :p", i);
	}
}
```
