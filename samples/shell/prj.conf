## CMakeLists.txt
```
# SPDX-License-Identifier: Apache-2.0

list(APPEND ZEPHYR_EXTRA_MODULES ${CMAKE_CURRENT_LIST_DIR}/../../modules/my_fs_shell)

cmake_minimum_required(VERSION 3.20.0)

find_package(Zephyr REQUIRED HINTS $ENV{ZEPHYR_BASE})
project(fs_shell)

FILE(GLOB app_sources src/*.c)
target_sources(app PRIVATE ${app_sources})
```

## prj.conf
```kconfig
#-------- Flash & file system --------#

CONFIG_FLASH=y

# these two are required by littlefs
CONFIG_FLASH_MAP=y
CONFIG_FLASH_PAGE_LAYOUT=y

# enable littlefs
CONFIG_FILE_SYSTEM=y
CONFIG_FILE_SYSTEM_LITTLEFS=y

#--------------- Shell ---------------#

# enable shell
CONFIG_SHELL=y

# disable uart shell backend which is enabled by default
CONFIG_SHELL_BACKEND_SERIAL=n

# use rtt for shell backend
CONFIG_USE_SEGGER_RTT=y
CONFIG_SHELL_BACKEND_RTT=y

# increase down buffer size to 64 to fit longer console commands (default 16)
CONFIG_SEGGER_RTT_BUFFER_SIZE_DOWN=64

#-------------- Logging --------------#

# enable logging into shell with <inf> level
CONFIG_LOG=y
CONFIG_SHELL_LOG_LEVEL_INF=y

# ensure robust logging
CONFIG_LOG_BLOCK_IN_THREAD=y
CONFIG_SHELL_BACKEND_RTT_LOG_MESSAGE_QUEUE_TIMEOUT=200

#----------- Shell features ----------#

# cut off some shell functionality to reduce resources consumption
CONFIG_SHELL_TAB=n
CONFIG_SHELL_CMDS_RESIZE=n

# enable custom fs shell
CONFIG_MY_FILE_SYSTEM_SHELL=y

# TESTING AREA
CONFIG_ARM_MPU=y
```

## mpu.conf
```kconfig
# not sure why is this needed
# with MPU enabled and this disabled everything works fine
CONFIG_MPU_ALLOW_FLASH_WRITE=y
```

## src/main.c
```c
/*
 * Copyright (c) 2019 Jan Van Winkel <jan.van_winkel@dxplore.eu>
 *
 * SPDX-License-Identifier: Apache-2.0
 */


#define LOG_LEVEL CONFIG_LOG_DEFAULT_LEVEL
#include <zephyr.h>
#include <logging/log.h>
LOG_MODULE_REGISTER(app);

void main(void)
{
    const int delay = 1000;

	LOG_INF("Starting spam in %d ms", delay);

	k_msleep(delay);

	for (int i = 0; i < 50; i++) {
		LOG_INF("spam #%d: blah blah bruh :p", i);
	}
}
```
