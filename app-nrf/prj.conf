## CMakeLists.txt
```
cmake_minimum_required(VERSION 3.20.0)

# custom zephyr modules
list(APPEND ZEPHYR_EXTRA_MODULES
    # ${CMAKE_CURRENT_LIST_DIR}/../modules/log_backend_my_fs
    ${CMAKE_CURRENT_LIST_DIR}/../modules/my_fs_shell
)

find_package(Zephyr REQUIRED HINTS $ENV{ZEPHYR_BASE})
project(app-nrf)

# interface code
add_subdirectory(${CMAKE_SOURCE_DIR}/../interface interface)

target_include_directories(app
    PRIVATE
        include
        include/${CONFIG_BOARD}
)

target_link_libraries(app PRIVATE interface_HID)

add_subdirectory(src)

zephyr_linker_sources(SECTIONS iterables_rom.ld)
```

## Kconfig
```
source "Kconfig.zephyr"

menu "App Configuration"
rsource "src/Kconfig"
endmenu
```

## prj.conf
```kconfig
#----------- Zephyr kernel -----------#

CONFIG_EVENTS=y

# large stack for workq thread because it handles BT
CONFIG_SYSTEM_WORKQUEUE_STACK_SIZE=4096

#------------ Application ------------#

CONFIG_APP_HID_SINK_TRANSPORT=y

CONFIG_POWER_ON_OFF_HOLD_TIME=500

#-------------- Drivers --------------#

# disable zephyr drivers, we have own stuff (e.g. to register custom ISRs)
CONFIG_GPIO=n
CONFIG_SPI=n
CONFIG_QDEC_NRFX=n

#------------ ADNS sensor ------------#

CONFIG_SENSOR=y

#-------- Flash & file system --------#

CONFIG_FLASH=y

# these two are required by littlefs
CONFIG_FLASH_MAP=y
CONFIG_FLASH_PAGE_LAYOUT=y

# enable littlefs
CONFIG_FILE_SYSTEM=y
CONFIG_FILE_SYSTEM_LITTLEFS=y
CONFIG_MAIN_STACK_SIZE=2048

#-------------- Settings -------------#

CONFIG_SETTINGS=y

# use fs backend
CONFIG_SETTINGS_FS=y

# mount point /int is defined in device tree
CONFIG_SETTINGS_FS_DIR="/int"
CONFIG_SETTINGS_FS_FILE="/int/.settings"

#--------------- Shell ---------------#

# enable shell
CONFIG_SHELL=y

# disable uart shell backend which is enabled by default
CONFIG_SHELL_BACKEND_SERIAL=n

# use rtt for shell backend
CONFIG_USE_SEGGER_RTT=y
CONFIG_SHELL_BACKEND_RTT=y

# increase down buffer size to 64 to fit longer console commands (default 16)
CONFIG_SEGGER_RTT_BUFFER_SIZE_DOWN=64

#----------- Shell features ----------#

# cut off some shell functionality to reduce resources consumption
CONFIG_SHELL_TAB=n
CONFIG_SHELL_CMDS_RESIZE=n

# enable custom shells
CONFIG_MY_FILE_SYSTEM_SHELL=y
CONFIG_APP_SHELL_HID_REPORT=y
CONFIG_APP_SHELL_HID_SRC_COLL=y
CONFIG_APP_SHELL_PLATFORM=y
CONFIG_APP_SHELL_SERVICES=y

#-------------- Logging --------------#

# enable logging into shell with <inf> level
CONFIG_LOG=y
CONFIG_SHELL_LOG_LEVEL_INF=y

# ensure robust logging
CONFIG_LOG_BLOCK_IN_THREAD=y
CONFIG_SHELL_BACKEND_RTT_LOG_MESSAGE_QUEUE_TIMEOUT=200

# # store logs to file
# CONFIG_LOG_BACKEND_MY_FS=y
# CONFIG_LOG_BACKEND_MY_FS_DIR="/int/log"
# CONFIG_LOG_BACKEND_MY_FS_FILE_PREFIX=""
# CONFIG_LOG_BACKEND_MY_FS_FILE_SIZE=1024
# # these are defaults when LOG_BACKEND_FS is selected
# CONFIG_LOG_PROCESS_THREAD_STACK_SIZE=2048

# ------------- Coredump ------------ #

CONFIG_DEBUG_COREDUMP=y
CONFIG_DEBUG_COREDUMP_BACKEND_FLASH_PARTITION=y
CONFIG_DEBUG_COREDUMP_MEMORY_DUMP_MIN=y

#------------- Bluetooth -------------#

CONFIG_BT=y

# use settings module
CONFIG_BT_SETTINGS=y

# mouse is a peripheral device
CONFIG_BT_PERIPHERAL=y

# preferred connection interval, in 1.25ms units
CONFIG_BT_PERIPHERAL_PREF_MIN_INT=6
CONFIG_BT_PERIPHERAL_PREF_MAX_INT=20

# safety
CONFIG_BT_SMP=y
CONFIG_BT_PRIVACY=y
CONFIG_BT_TINYCRYPT_ECC=y
CONFIG_BT_SIGNING=y
CONFIG_BT_SMP_ENFORCE_MITM=y
CONFIG_BT_KEYS_OVERWRITE_OLDEST=y
CONFIG_BT_HIDS_DEFAULT_PERM_RW_ENCRYPT=y

# services
CONFIG_BT_BAS=y
CONFIG_BT_DIS=y
CONFIG_BT_HIDS=y

# device information
# PnP is mandatory according to HID over GATT profile specification, using values from Nordic's example
CONFIG_BT_DIS_PNP=y
CONFIG_BT_DIS_PNP_VID_SRC=2
CONFIG_BT_DIS_PNP_VID=0x1915
CONFIG_BT_DIS_PNP_PID=0xEEEE
CONFIG_BT_DIS_MODEL="MouseV2"
CONFIG_BT_DIS_MANUF="Taras Radchenko"
CONFIG_BT_DEVICE_NAME="My mouse"
CONFIG_BT_DEVICE_APPEARANCE=962

# may be enabled later to allow user rename the device?
CONFIG_BT_DEVICE_NAME_DYNAMIC=n
# CONFIG_BT_DEVICE_NAME_MAX=128

# provides hci_core?
CONFIG_BT_CONN_CTX=y

CONFIG_BT_MAX_PAIRED=2
CONFIG_BT_GATT_CHRC_POOL_SIZE=8

#----- Ghost powering workarounds ----#

# This section enables some workarounds which minimize ghost powering of AVR,
# which is a result of signals on SPI bus going through AVR's internal protection
# diodes on GPIO pins and reaching Vcc (which is normally powered by USB).
# The main idea behind these workarounds is to keep signal lines low when possible,
# and account for Vcc capacitors charge time.

# disable CLK after 2ms of inactivity on SPI (it's normally high when inactive)
CONFIG_SPI_DISABLE_CLK_DELAY=2000
# wait for 500us after bringing CLK high to charge up AVR's capacitors
CONFIG_SPI_ENABLE_CLK_DELAY=500

#------------ Testing area -----------#

CONFIG_SKIP_BOOT_CONDITION=n
# CONFIG_BT_HIDS_INPUT_REP_MAX=2
# CONFIG_BT_HIDS_OUTPUT_REP_MAX=0
# CONFIG_BT_HIDS_FEATURE_REP_MAX=0
```

## src/main.c
```c
#include <zephyr/kernel.h>

#include "services/button_mode.h"

void main() {
    while (true) {
        check_button_mode();
        k_msleep(2);
    }
}
```

## include/devices.h
```c
#pragma once

#include <zephyr/device.h>

extern const struct device *optical_sensor;
```

## include/hidenc.h
```c
#pragma once

#include <stdbool.h>

#include "hid_report_struct.h"
#include "transport/transport.h"

bool hidenc_maybe_update_client(struct transport* transport, struct hid_report* report);
```

## include/util.h
```c
#pragma once

#include <stdint.h>

#include <zephyr/arch/common/ffs.h>
#include <zephyr/sys/util_macro.h>

/**
 * @brief Helper function for iterating over positions of set bits in a bitmask.
 *
 * The bitmask is modified after each call (set bits are cleared one by one).
 * The function should only be called when @p mask is non-zero.
 *
 * @param mask Pointer to non-zero bitmask
 * @return Position of the first set least significant bit
 */
static inline uint32_t get_next_bit_pos(uint32_t* mask) {
    uint32_t pos = find_lsb_set(*mask) - 1;
    WRITE_BIT(*mask, pos, 0);
    return pos;
}
```

## src/devices.c
```c
#include "devices.h"

#include <zephyr/devicetree.h>

const struct device* optical_sensor = DEVICE_DT_GET(DT_NODELABEL(optical_sensor));
```

## src/hidenc.c
```c
#include "hidenc.h"

#include <stdbool.h>

#include <hal/nrf_gpio.h>
#include <zephyr/drivers/sensor.h>
#include <zephyr/kernel.h>
#include <zephyr/logging/log.h>

#include "devices.h"
#include "hid_report_struct.h"
#include "platform/gpio.h"
#include "platform/qdec.h"
#include "shell/report.h"
#include "transport/transport.h"

LOG_MODULE_REGISTER(hidenc);

static inline void fill_buttons(struct hid_report *report, bool *updated) {
    static const uint32_t btn_port_mask = \
        BIT(PINOF(button_left)) | BIT(PINOF(button_right)) | BIT(PINOF(button_middle));
    static uint32_t prev_port_state = 0;
    uint32_t port_state = ~(nrf_gpio_port_in_read(NRF_GPIO) & btn_port_mask);

    if (port_state != prev_port_state) {
        *updated = true;
        prev_port_state = port_state;
        report->buttons.s.left   = (port_state >> PINOF(button_left)) & 1;
        report->buttons.s.right  = (port_state >> PINOF(button_right)) & 1;
        report->buttons.s.middle = (port_state >> PINOF(button_middle)) & 1;
    }
}

static inline void fill_rotation(struct hid_report *report, bool *updated) {
    static int acc = 0;

#ifdef CONFIG_APP_SHELL_HID_REPORT
    if (report_shell_fill_rotation(report)) {
        *updated = true;
        return;
    }
#endif

    int value = qdec_read_acc();

    if (value) {
        acc += value;
        int delta = acc / 2;
        if (delta) {
            *updated = true;
            report->wheel_delta = delta;
            acc = acc % 2;
        }
    }
}

static inline void fill_movement(struct hid_report *report, bool *updated) {
    struct sensor_value value;

#ifdef CONFIG_APP_SHELL_HID_REPORT
    if (report_shell_fill_movement(report)) {
        *updated = true;
        return;
    }
#endif

    if (nrf_gpio_pin_read(PINOFPROP(optical_sensor, mot_gpios)) == 0) {
        // motion interrupt low -> data available, read will clear it
        *updated = true;

        sensor_sample_fetch(optical_sensor);
        sensor_channel_get(optical_sensor, SENSOR_CHAN_POS_DX, &value);
        report->x_delta = value.val1;
        sensor_channel_get(optical_sensor, SENSOR_CHAN_POS_DY, &value);
        report->y_delta = -value.val1;
    }
}

bool hidenc_maybe_update_client(struct transport* transport, struct hid_report* report) {
    int err = 0;
    bool updated = false;

    fill_buttons(report, &updated);
    fill_rotation(report, &updated);
    fill_movement(report, &updated);

    if (updated) {
        if ((err = transport->send(report))) {
            LOG_WRN("send returned %d", err);
        }
        clear_non_persistent_data_in_report(report);
    }

    return updated;
}

// todo: hidenc should probably be split & moved to services
// until then, initialize sensor's interrupt gpio here

static int hidenc_init(const struct device* dev) {
    ARG_UNUSED(dev);

    nrf_gpio_cfg_input(PINOFPROP(optical_sensor, mot_gpios), NRF_GPIO_PIN_NOPULL);

    return 0;
}

SYS_INIT(hidenc_init, APPLICATION, 0);
```
